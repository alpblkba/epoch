## CMakeLists.txt
```
cmake_minimum_required(VERSION 3.20.0)

find_package(Zephyr REQUIRED HINTS $ENV{ZEPHYR_BASE})

project(epoch_uart_echo)

set(EPOCH_ROOT ${CMAKE_CURRENT_SOURCE_DIR}/../..)

# Polling UART echo by default; irq.conf selects the interrupt-driven echo, which links the portable EPOCH ring;
# retention.conf with boards/retention.overlay selects the retention probe, controller.conf with the same overlay the EPOCH controller,
# and fault.conf added to controller.conf the build with the test-only fault-injection endpoint.
if(CONFIG_EPOCH_RETENTION_PROBE)
  target_sources(app PRIVATE src/retention_probe.c ${EPOCH_ROOT}/core/src/crc32.c)
  target_include_directories(app PRIVATE ${EPOCH_ROOT}/core/include)
  target_compile_options(app PRIVATE -Wall -Wextra -Wshadow -Werror)
elseif(CONFIG_EPOCH_CONTROLLER_APP)
  set(EPOCH_CORE controller.c journal.c msg.c ring.c crc32.c wire.c)
  list(TRANSFORM EPOCH_CORE PREPEND ${EPOCH_ROOT}/core/src/)
  target_sources(app PRIVATE src/controller_app.c ${EPOCH_CORE})
  target_include_directories(app PRIVATE ${EPOCH_ROOT}/core/include)
  target_compile_options(app PRIVATE -Wall -Wextra -Wshadow -Werror)
  set_source_files_properties(${EPOCH_CORE} PROPERTIES COMPILE_OPTIONS "-Wpedantic;-Wconversion;-Wsign-conversion")
  if(CONFIG_EPOCH_FAULT_TEST)
    target_sources(app PRIVATE src/fault_hooks.c)
    set_source_files_properties(src/fault_hooks.c PROPERTIES COMPILE_OPTIONS "-Wpedantic;-Wconversion;-Wsign-conversion")
  endif()
elseif(CONFIG_UART_INTERRUPT_DRIVEN)
  target_sources(app PRIVATE src/echo_irq.c ${EPOCH_ROOT}/core/src/ring.c)
  target_include_directories(app PRIVATE ${EPOCH_ROOT}/core/include)
  target_compile_options(app PRIVATE -Wall -Wextra -Wshadow -Werror)
  # Zephyr headers are not -Wconversion clean, so the native project's conversion warnings apply to the portable ring only.
  set_source_files_properties(${EPOCH_ROOT}/core/src/ring.c PROPERTIES COMPILE_OPTIONS "-Wpedantic;-Wconversion;-Wsign-conversion")
else()
  target_sources(app PRIVATE src/main.c)
endif()
```

## Kconfig
```
config EPOCH_RX_ZEPHYR_RING_BUF
	bool "Use Zephyr ring_buf instead of the EPOCH ring on the interrupt-driven receive path"
	depends on UART_INTERRUPT_DRIVEN
	select RING_BUFFER
	help
	  Compile-time comparator for isolating a suspected defect in the EPOCH ring. The EPOCH ring in core/src/ring.c stays the primary receive path.

config EPOCH_RETENTION_PROBE
	bool "Build the R1/R2 retained-memory probe instead of an echo"
	select REBOOT
	help
	  Selected by retention.conf together with boards/retention.overlay.
	  Reports reset flags, FLASH_OPTR and the R1 (SRAM1 noinit) and R2
	  (backup SRAM) probe records over USART1 as text lines.

config EPOCH_CONTROLLER_APP
	bool "Build the EPOCH controller (EP0 and EP1 over the UART wire codec)"
	select REBOOT
	help
	  Selected by controller.conf together with boards/retention.overlay,
	  which enables the backup SRAM that holds the journal.

config EPOCH_FAULT_TEST
	bool "Test-only fault arming and diagnostic endpoint"
	depends on EPOCH_CONTROLLER_APP
	help
	  Adds TEST_ARM and TEST_DIAG handling for reset-injection
	  experiments. Selected by fault.conf; never part of a production image.

config EPOCH_FAULT_CORRUPT
	bool "Corrupted-slot image: forge mode 1 corrupts the newest committed slot"
	depends on EPOCH_FAULT_TEST
	help
	  Selected by corrupt.conf for the dedicated corrupted-slot image
	  only. TEST_ARM code 13 mode 1 then changes bit 0 of the counter
	  word of the newest valid slot in place, instead of writing an
	  equal-seq copy. The standard fault image is built without it.

source "Kconfig.zephyr"
```

## prj.conf
```kconfig
CONFIG_SERIAL=y
CONFIG_CONSOLE=n
CONFIG_UART_CONSOLE=n
CONFIG_LOG=n
CONFIG_BOOT_BANNER=n
```

## controller.conf
```kconfig
CONFIG_EPOCH_CONTROLLER_APP=y
CONFIG_UART_INTERRUPT_DRIVEN=y
CONFIG_ENTROPY_GENERATOR=y
CONFIG_PRINTK=n
# worst measured path (parse, controller, announce, encode) is about 920 B; measured with -fstack-usage for the Cortex-M33
CONFIG_MAIN_STACK_SIZE=2048
```

## corrupt.conf
```kconfig
CONFIG_EPOCH_FAULT_CORRUPT=y
```

## fault.conf
```kconfig
CONFIG_EPOCH_FAULT_TEST=y
```

## retention.conf
```kconfig
CONFIG_EPOCH_RETENTION_PROBE=y
```

## boards/retention.overlay
```dts
/* Retained-memory backend R2: the 2 KiB backup SRAM (R2) is disabled in stm32u5.dtsi; enabling it lets the stm32_backup_sram driver turn on its clocks and backup-domain write access. */
&backup_sram {
	status = "okay";
};
```

## src/main.c
```c
#include <zephyr/device.h>
#include <zephyr/devicetree.h>
#include <zephyr/drivers/uart.h>

#define UART_NODE DT_CHOSEN(zephyr_console)

int main(void)
{
    const struct device *uart = DEVICE_DT_GET(UART_NODE);
    unsigned char byte;

    if (!device_is_ready(uart)) {
        return -1;
    }

    while (1) {
        if (uart_poll_in(uart, &byte) == 0) {
            uart_poll_out(uart, byte);
        }
    }

    return 0;
}
```

## src/controller_app.c
```c
/* EPOCH controller, session control (EP0) and retained transactions (EP1): the portable EPOCH controller (core/src/controller.c) behind the UART wire codec, with its journal in backup SRAM (R2, qualified by the retention probe for software, IWDG and pin resets).
 * Data path as in the interrupt-driven echo (echo_irq.c): the USART1 RX interrupt fills the EPOCH SPSC ring, and this thread drains it, parses frames, runs the controller and transmits with uart_poll_out. */

#include <soc.h>
#include <zephyr/device.h>
#include <zephyr/drivers/entropy.h>
#include <zephyr/drivers/uart.h>
#include <zephyr/kernel.h>
#include <zephyr/linker/section_tags.h>
#include <zephyr/sys/reboot.h>

#include "epoch/controller.h"
#include "epoch/crc32.h"
#include "epoch/ring.h"
#include "epoch/wire.h"
#ifdef CONFIG_EPOCH_FAULT_TEST
#include "fault_hooks.h"
#endif

#define UART_NODE DT_CHOSEN(zephyr_console)
#define RX_CAPACITY 256u
#define TICK_MS 10
#define JOURNAL_MAGIC_VERSION 0x45504301u /* MAGIC 0x455043 ("EPC"), VERSION 1; provisional */
#define R2_ERA_MARKER 0xE9A0C0DEu         /* TAMP_BKP30R: cold initialization of the R2 journal completed since the last backup-domain reset */

static const struct device *const uart = DEVICE_DT_GET(UART_NODE);
static const struct device *const rng = DEVICE_DT_GET(DT_CHOSEN(zephyr_entropy));

static __stm32_backup_sram_section struct epoch_retained retained;

static struct epoch_ring rx;
static uint8_t rx_buf[RX_CAPACITY];
static K_SEM_DEFINE(rx_sem, 0, 1);

/* Debugger-only counters, one writer each, no firmware reader. */
struct ctrl_stats {
    uint32_t ring_drops;   /* ISR */
    uint32_t overruns;     /* ISR, lower bound: uart_fifo_read clears an overrun latched after the sample */
    uint32_t wire_errors;  /* thread: frames rejected by the codec */
    uint32_t rng_errors;   /* thread */
};
volatile struct ctrl_stats ctrl_stats;

static void rx_isr(const struct device *dev, void *user_data)
{
    uint8_t byte;
    bool queued = false;

    ARG_UNUSED(user_data);
    uart_irq_update(dev);
    if (uart_err_check(dev) & UART_ERROR_OVERRUN) {
        ctrl_stats.overruns++;
    }
    while (uart_irq_rx_ready(dev) > 0 && uart_fifo_read(dev, &byte, 1) == 1) {
        if (epoch_ring_put(&rx, byte)) {
            queued = true;
        } else {
            ctrl_stats.ring_drops++;
        }
    }
    if (queued) {
        k_sem_give(&rx_sem);
    }
}

static uint64_t rand64(void *ctx)
{
    ARG_UNUSED(ctx);
    uint64_t v = 0;
    /* The STM32 RNG driver reports seed and clock errors; a failure is counted and retried rather than replaced by a constant. */
    while (entropy_get_entropy(rng, (uint8_t *)&v, sizeof(v)) != 0) {
        ctrl_stats.rng_errors++;
        k_msleep(1);
    }
    return v;
}

static uint32_t new_era(void *ctx)
{
    uint32_t e;
    do {
        e = (uint32_t)rand64(ctx);
    } while (e == 0);
    return e;
}

static void send(void *ctx, const struct epoch_msg *m)
{
    ARG_UNUSED(ctx);
    uint8_t frame[EPOCH_WIRE_MAX_FRAME];
    size_t n = epoch_wire_encode(m, frame, sizeof(frame));
    for (size_t i = 0; i < n; i++) {
        uart_poll_out(uart, frame[i]);
    }
}

static void barrier(void *ctx)
{
    ARG_UNUSED(ctx);
    __DSB();
}

static const struct epoch_ctrl_config cfg = {
    .journal = {JOURNAL_MAGIC_VERSION, epoch_crc32_words},
    .t_pending_ms = 2000,
    .version_min = EPOCH_WIRE_VERSION,
    .version_max = EPOCH_WIRE_VERSION,
    .capabilities = 0,
};
static uint32_t boot_csr;

#ifdef CONFIG_EPOCH_FAULT_TEST
/* Reset injection: a test-only endpoint arms one reset at (checkpoint, txid). Just before the reset, the "checkpoint reached" marker goes to R1 (SRAM1 .noinit, qualified by the retention probe), the store not under test, so a journal fault cannot hide or forge it. Codes 9 to 12 arm a reset at a cold-initialization store of the next boot, kept in R1 across the preparatory reset; code 13 forges an inconsistent slot pair. */
static __noinit struct fault_record marker, arm_record;
static struct {
    bool armed;
    uint32_t run, checkpoint, txid;
} arm;
static struct fault_cold cold_arm;

static bool checkpoint(void *ctx, enum epoch_checkpoint cp, uint32_t txid)
{
    ARG_UNUSED(ctx);
    if (!arm.armed || (uint32_t)cp != arm.checkpoint || txid != arm.txid) {
        return false;
    }
    arm.armed = false;
    fault_record_write(&marker, FAULT_MARKER_MAGIC, arm.run, arm.checkpoint, txid, barrier, NULL);
    return true; /* the controller stops here and main resets */
}

/* uart_poll_out returns once a byte is in TDR, so with the USART1 FIFO disabled (no fifo-enable in the devicetree) two bytes, about 0.17 ms at 115200 baud, are still on their way, and a reset cuts them. Before a test reset the firmware therefore waits for USART_ISR.TC, which the hardware sets when TDR and the shift register are empty after a stop bit; the driver's uart_irq_tx_complete reads the same flag but is defined only inside the UART interrupt. */
#define TX_LIMIT_US 1000u
static void tx_put(void *ctx, uint8_t byte)
{
    ARG_UNUSED(ctx);
    uart_poll_out(uart, byte);
}
static bool tx_sent(void *ctx)
{
    ARG_UNUSED(ctx);
    return (((USART_TypeDef *)DT_REG_ADDR(UART_NODE))->ISR & USART_ISR_TC) != 0u;
}
static void tx_wait(void *ctx, uint32_t us)
{
    ARG_UNUSED(ctx);
    k_busy_wait(us);
}
static const struct fault_tx tx = {NULL, tx_put, tx_sent, tx_wait};

/* Sends the last reply completely, then resets. */
static FUNC_NORETURN void reply_and_reset(const struct epoch_msg *r)
{
    (void)fault_send_complete(&tx, r, TX_LIMIT_US);
    sys_reboot(SYS_REBOOT_COLD);
}

static bool cold_store_hook(void *ctx, const volatile uint32_t *slot, unsigned index)
{
    ARG_UNUSED(ctx);
    ARG_UNUSED(slot);
    if (!fault_cold_hit(&cold_arm, index)) {
        return false;
    }
    if (cold_arm.arm.txid == FAULT_NEXT_WARM) {
        TAMP->BKP30R = R2_ERA_MARKER; /* the next boot is judged warm, so only the core's era guard protects it */
    }
    fault_record_write(&marker, FAULT_MARKER_MAGIC, cold_arm.arm.run, index, cold_arm.arm.txid, barrier, NULL);
    return true; /* epoch_ctrl_boot returns EPOCH_CTRL_RESET and main resets */
}

/* Runs before epoch_ctrl_boot: takes and clears an armed cold-initialization reset, and reports it with an unsolicited TEST_DIAG_REPLY carrying this boot's reset cause, which identifies the preparatory reset. */
static void fault_boot(uint32_t csr)
{
    fault_cold_take(&arm_record, &cold_arm, barrier, NULL);
    if (cold_arm.armed) {
        struct epoch_msg r = {0};
        r.type = EPOCH_MSG_TEST_DIAG_REPLY;
        r.run = cold_arm.arm.run;
        r.checkpoint = cold_arm.arm.checkpoint;
        r.txid = cold_arm.arm.txid;
        r.reset_cause = csr;
        (void)fault_send_complete(&tx, &r, TX_LIMIT_US); /* on a timeout the host sees a damaged frame and the trial stays INCONCLUSIVE */
        RCC->CSR |= RCC_CSR_RMVF; /* so the boot after the injected reset reports only that reset */
    }
}

/* Handles the test messages before the controller sees them; returns true when m was one. */
static bool fault_test(const struct epoch_msg *m)
{
    struct epoch_msg r = {0};
    if (m->type == EPOCH_MSG_TEST_ARM) {
        enum fault_request q = fault_decode(m->checkpoint, m->txid);
        if (q == FAULT_IGNORE) {
            return true;
        }
        marker.magic = 0; /* a marker from an earlier trial can never match this one */
        __DSB();
        r = *m;
        r.type = EPOCH_MSG_TEST_ARM_ACK;
        if (q == FAULT_COLD) {
            fault_record_write(&arm_record, FAULT_ARM_MAGIC, m->run, m->checkpoint, m->txid, barrier, NULL);
            TAMP->BKP30R = 0; /* the next boot is judged cold and runs cold initialization, where the arm fires */
            __DSB();
            reply_and_reset(&r); /* preparatory reset */
        }
        if (q == FAULT_FORGE) {
            if (!fault_forge_pair(&cfg.journal, retained.slots, retained.era, m->txid, barrier, NULL)) {
                return true; /* no valid record to copy: nothing forged, no acknowledgement */
            }
            fault_record_write(&marker, FAULT_MARKER_MAGIC, m->run, m->checkpoint, m->txid, barrier, NULL);
            reply_and_reset(&r); /* warm reset: TAMP_BKP30R stays, so the core alone meets the pair at boot */
        }
        arm.armed = true;
        arm.run = m->run;
        arm.checkpoint = m->checkpoint;
        arm.txid = m->txid;
    } else if (m->type == EPOCH_MSG_TEST_DIAG) {
        r.type = EPOCH_MSG_TEST_DIAG_REPLY;
        r.marker_valid = fault_record_valid(&marker, FAULT_MARKER_MAGIC);
        r.run = marker.run;
        r.checkpoint = marker.checkpoint;
        r.txid = marker.txid;
        r.reset_cause = boot_csr;
    } else {
        return m->type >= EPOCH_MSG_TEST_ARM; /* a reply type: ignored */
    }
    send(NULL, &r);
    return true;
}
#else
#define checkpoint NULL
#define cold_store_hook NULL
static inline void fault_boot(uint32_t csr)
{
    ARG_UNUSED(csr);
}
static bool fault_test(const struct epoch_msg *m)
{
    ARG_UNUSED(m);
    return false;
}
#endif

static const struct epoch_ctrl_env env = {NULL, rand64, new_era, send, barrier, checkpoint, cold_store_hook};
static struct epoch_ctrl ctrl;
static struct epoch_wire_parser parser;

int main(void)
{
    const uint32_t csr = boot_csr = RCC->CSR; /* first, before anything can change it; reported raw in ANNOUNCE */

    if (!device_is_ready(uart) || !device_is_ready(rng) || !epoch_ring_init(&rx, rx_buf, RX_CAPACITY) ||
        uart_irq_callback_user_data_set(uart, rx_isr, NULL) != 0) {
        return -1;
    }
    RCC->APB3ENR |= RCC_APB3ENR_RTCAPBEN; /* TAMP registers; backup-domain write access is enabled by the backup SRAM driver */
    (void)RCC->APB3ENR;

    /* Cold when power was lost (BOR covers power-on) or when cold initialization never completed since the last backup-domain reset: the marker is written only after epoch_ctrl_boot returns, so a reset inside cold initialization repeats it. */
    const bool cold = (csr & RCC_CSR_BORRSTF) != 0u || TAMP->BKP30R != R2_ERA_MARKER;
    if (cold) {
        /* Withdraw the marker before cold initialization touches a slot, so a reset anywhere inside it leads to cold initialization again on the next boot, whatever the reset flags say. */
        TAMP->BKP30R = 0;
        __DSB();
    }
    epoch_wire_parser_init(&parser);
    uart_irq_rx_enable(uart); /* bytes arriving from here on wait in the ring, so a PROBE answering ANNOUNCE is not lost */
    fault_boot(csr);
    if (epoch_ctrl_boot(&ctrl, &cfg, &env, &retained, cold, csr, k_uptime_get_32()) == EPOCH_CTRL_RESET && IS_ENABLED(CONFIG_EPOCH_FAULT_TEST)) {
        sys_reboot(SYS_REBOOT_COLD); /* a test hook stopped cold initialization: no ANNOUNCE was sent, and neither the completed-boot marker nor the flag clearing may follow */
    }
    TAMP->BKP30R = R2_ERA_MARKER;
    __DSB();
    RCC->CSR |= RCC_CSR_RMVF; /* after boot used them, so the next ANNOUNCE reports only its own reset */

    for (;;) {
        k_sem_take(&rx_sem, K_MSEC(TICK_MS));
        uint8_t byte;
        while (epoch_ring_get(&rx, &byte)) {
            struct epoch_msg m;
            enum epoch_wire_status s = epoch_wire_feed(&parser, byte, &m);
            if (s == EPOCH_WIRE_OK) {
                if (!fault_test(&m) && epoch_ctrl_receive(&ctrl, &m, k_uptime_get_32()) == EPOCH_CTRL_RESET) {
                    sys_reboot(SYS_REBOOT_COLD); /* NVIC_SystemReset, after a DSB */
                }
            } else if (s != EPOCH_WIRE_NONE) {
                ctrl_stats.wire_errors++;
            }
        }
        epoch_ctrl_tick(&ctrl, k_uptime_get_32());
    }
}
```

## src/echo_irq.c
```c
/* Interrupt-driven UART echo. The USART1 receive interrupt is the only producer of the RX ring and main() is the only consumer, which sends each byte back with uart_poll_out. Built when CONFIG_UART_INTERRUPT_DRIVEN=y (irq.conf); src/main.c remains the polling echo. */

#include <zephyr/device.h>
#include <zephyr/devicetree.h>
#include <zephyr/drivers/uart.h>
#include <zephyr/kernel.h>

#define UART_NODE DT_CHOSEN(zephyr_console)
#define RX_CAPACITY 256u /* power of two; 22 ms of input at 115200 baud 8N1 */

/* Debugger-only instrumentation, not synchronization. Each field has one writer and no firmware reader, so no atomic read-modify-write is needed; volatile forbids the compiler from dropping or merging the stores. A debugger reads each aligned word in one access. The fields are zeroed at every boot (.bss) and wrap modulo 2^32. */
struct echo_stats {
    uint32_t rx_bytes;    /* ISR: bytes queued */
    uint32_t ring_drops;  /* ISR: bytes lost because the ring was full; exact */
    uint32_t overruns;    /* ISR: interrupts that found the USART overrun flag; a lower bound, see rx_isr */
    uint32_t line_errors; /* ISR: interrupts that found a framing, noise, parity or break flag; a lower bound */
    uint32_t tx_bytes;    /* thread: bytes handed to uart_poll_out */
};
volatile struct echo_stats echo_stats;

#ifdef CONFIG_EPOCH_RX_ZEPHYR_RING_BUF
#include <zephyr/sys/ring_buffer.h>

/* Zephyr ring_buf comparator, used only to isolate a suspected EPOCH ring defect. */
RING_BUF_DECLARE(rx_rb, RX_CAPACITY);

static bool rx_init(void)
{
    return true;
}

static bool rx_put(uint8_t byte)
{
    return ring_buf_put(&rx_rb, &byte, 1) == 1u;
}

static bool rx_get(uint8_t *byte)
{
    return ring_buf_get(&rx_rb, byte, 1) == 1u;
}
#else
#include "epoch/ring.h"

static struct epoch_ring rx;
static uint8_t rx_buf[RX_CAPACITY];

static bool rx_init(void)
{
    return epoch_ring_init(&rx, rx_buf, RX_CAPACITY);
}

static bool rx_put(uint8_t byte)
{
    return epoch_ring_put(&rx, byte);
}

static bool rx_get(uint8_t *byte)
{
    return epoch_ring_get(&rx, byte);
}
#endif

static K_SEM_DEFINE(rx_sem, 0, 1);

static void rx_isr(const struct device *dev, void *user_data)
{
    uint8_t byte;
    bool queued = false;

    ARG_UNUSED(user_data);
    uart_irq_update(dev);
    /* uart_fifo_read clears the overrun flag without reporting it, so the flags are sampled first. The count is a lower bound: an overrun latched after this sample is cleared silently by uart_fifo_read, and one flag can stand for several lost bytes. */
    int err = uart_err_check(dev);
    if (err > 0) {
        if (err & UART_ERROR_OVERRUN)
            echo_stats.overruns++;
        if (err & ~UART_ERROR_OVERRUN)
            echo_stats.line_errors++;
    }
    /* Each pass consumes one received byte, and the next can arrive only one character time (87 us) later, so the loop ends as soon as the line pauses. */
    while (uart_irq_rx_ready(dev) > 0 && uart_fifo_read(dev, &byte, 1) == 1) {
        if (rx_put(byte)) {
            echo_stats.rx_bytes++;
            queued = true;
        } else {
            echo_stats.ring_drops++;
        }
    }
    if (queued)
        k_sem_give(&rx_sem);
}

int main(void)
{
    const struct device *uart = DEVICE_DT_GET(UART_NODE);
    uint8_t byte;

    /* The ring and the statically defined semaphore are ready before the callback is installed and RX interrupts are enabled. */
    if (!device_is_ready(uart) || !rx_init() || uart_irq_callback_user_data_set(uart, rx_isr, NULL) != 0)
        return -1;
    uart_irq_rx_enable(uart);

    for (;;) {
        k_sem_take(&rx_sem, K_FOREVER);
        /* One token can stand for many bytes. A byte queued after the drain empties the ring also gives a token, so the next take returns at once and nothing is stranded. */
        while (rx_get(&byte)) {
            uart_poll_out(uart, byte);
            echo_stats.tx_bytes++;
        }
    }
}
```

## src/fault_hooks.c
```c
#include "fault_hooks.h"

#include "epoch/crc32.h"
#include "epoch/wire.h"

#define W EPOCH_JOURNAL_WORDS

enum fault_request fault_decode(uint32_t checkpoint, uint32_t txid)
{
    if (checkpoint <= EPOCH_CP_F3)
        return FAULT_RUNTIME;
    if (txid > 1u)
        return FAULT_IGNORE;
    if (checkpoint >= EPOCH_STORE_COLD_UNSET_ERA && checkpoint <= EPOCH_STORE_COLD_ERA)
        return FAULT_COLD;
    return checkpoint == FAULT_CP_FORGE ? FAULT_FORGE : FAULT_IGNORE;
}

void fault_record_write(volatile struct fault_record *r, uint32_t magic, uint32_t run, uint32_t checkpoint, uint32_t txid, epoch_barrier_fn barrier, void *ctx)
{
    const uint32_t w[3] = { run, checkpoint, txid };
    r->magic = 0;
    barrier(ctx);
    r->run = run;
    r->checkpoint = checkpoint;
    r->txid = txid;
    r->crc = epoch_crc32_words(w, 3);
    barrier(ctx);
    r->magic = magic;
    barrier(ctx);
}

bool fault_record_valid(const volatile struct fault_record *r, uint32_t magic)
{
    const uint32_t w[3] = { r->run, r->checkpoint, r->txid };
    return r->magic == magic && r->crc == epoch_crc32_words(w, 3);
}

void fault_cold_take(volatile struct fault_record *stored, struct fault_cold *c, epoch_barrier_fn barrier, void *ctx)
{
    bool valid = fault_record_valid(stored, FAULT_ARM_MAGIC);
    c->arm.magic = stored->magic;
    c->arm.run = stored->run;
    c->arm.checkpoint = stored->checkpoint;
    c->arm.txid = stored->txid;
    c->arm.crc = stored->crc;
    stored->magic = 0; /* unconditionally, so power-on contents can never arm a later boot either */
    barrier(ctx);
    c->armed = valid && fault_decode(c->arm.checkpoint, c->arm.txid) == FAULT_COLD;
}

bool fault_cold_hit(struct fault_cold *c, unsigned index)
{
    if (!c->armed || index != c->arm.checkpoint)
        return false;
    c->armed = false;
    return true;
}

bool fault_send_complete(const struct fault_tx *tx, const struct epoch_msg *m, uint32_t limit_us)
{
    uint8_t frame[EPOCH_WIRE_MAX_FRAME];
    size_t n = epoch_wire_encode(m, frame, sizeof frame);
    for (size_t i = 0; i < n; i++)
        tx->put(tx->ctx, frame[i]);
    for (uint32_t waited = 0; !tx->sent(tx->ctx); waited += FAULT_TX_POLL_US) {
        if (waited >= limit_us)
            return false;
        tx->wait_us(tx->ctx, FAULT_TX_POLL_US);
    }
    return true;
}

bool fault_forge_pair(const struct epoch_journal_params *p, volatile uint32_t *slots, uint32_t era, uint32_t mode, epoch_barrier_fn barrier, void *ctx)
{
    int n = epoch_journal_newest(p, slots, era);
    if (n < 0)
        return false;
#ifdef CONFIG_EPOCH_FAULT_CORRUPT
    if (mode == FAULT_FORGE_SEQ_EQUAL) { /* the only write: w0 stays MAGIC|VERSION and the CRC no longer matches */
        slots[(unsigned)n * W + 5u] ^= 1u;
        barrier(ctx);
        return true;
    }
#endif
    uint32_t w[W];
    for (unsigned i = 0; i < W; i++)
        w[i] = slots[(unsigned)n * W + i];
    w[6] += mode == FAULT_FORGE_SEQ_EQUAL ? 0u : 2u;
    w[W - 1] = p->crc(w, W - 1);
    volatile uint32_t *s = slots + (n == 0 ? W : 0u);
    s[0] = 0;
    barrier(ctx);
    for (unsigned i = 1; i < W; i++)
        s[i] = w[i];
    barrier(ctx);
    s[0] = w[0];
    barrier(ctx);
    return true;
}
```

## src/fault_hooks.h
```c
#ifndef EPOCH_FAULT_HOOKS_H
#define EPOCH_FAULT_HOOKS_H

/* Test-only reset injection for the fault build (fault.conf), kept free of Zephyr headers so the native tests in tests/fault_hooks compile the same code. Never part of a production image. */

#include <stdbool.h>
#include <stdint.h>

#include "epoch/journal.h"
#include "epoch/types.h"

#define FAULT_MARKER_MAGIC 0x4D4B5231u /* "MKR1": checkpoint reached */
#define FAULT_ARM_MAGIC 0x41524D31u    /* "ARM1": cold-initialization reset armed for the next boot */

/* TEST_ARM checkpoint codes: 0 to 4 are enum epoch_checkpoint, 9 to 12 the cold-initialization stores EPOCH_STORE_COLD_*, 13 the inconsistent-pair forge. For 9 to 13 the txid field carries the mode. */
enum { FAULT_CP_FORGE = 13 };
enum { FAULT_NEXT_COLD = 0, FAULT_NEXT_WARM = 1 };          /* codes 9 to 12: how the firmware judges the boot after the injected reset */
enum { FAULT_FORGE_SEQ_PLUS_2 = 0, FAULT_FORGE_SEQ_EQUAL = 1 }; /* code 13: seq of the forged copy */
enum fault_request { FAULT_IGNORE, FAULT_RUNTIME, FAULT_COLD, FAULT_FORGE };

/* Retained record in SRAM1 .noinit: run, checkpoint and txid, their CRC, and the magic written last. */
struct fault_record {
    uint32_t magic, run, checkpoint, txid, crc;
};

/* An armed cold-initialization reset taken at boot; fires at most once. */
struct fault_cold {
    struct fault_record arm;
    bool armed;
};

enum fault_request fault_decode(uint32_t checkpoint, uint32_t txid);
/* Writes run, checkpoint, txid and the CRC, a barrier, then the magic and a barrier, so a torn record reads invalid and a complete one is committed on return. */
void fault_record_write(volatile struct fault_record *r, uint32_t magic, uint32_t run, uint32_t checkpoint, uint32_t txid, epoch_barrier_fn barrier, void *ctx);
bool fault_record_valid(const volatile struct fault_record *r, uint32_t magic);
/* Clears the stored arm, with a barrier, before returning what it held, so no later reset can fire it again; c->armed is true only for a valid cold-initialization arm. */
void fault_cold_take(volatile struct fault_record *stored, struct fault_cold *c, epoch_barrier_fn barrier, void *ctx);
/* True once, at the armed store index. */
bool fault_cold_hit(struct fault_cold *c, unsigned index);
/* A byte transmitter as the firmware sees it: put returns once the byte is queued, sent reports that every queued byte, stop bit included, has left the line. */
struct fault_tx {
    void *ctx;
    void (*put)(void *ctx, uint8_t byte);
    bool (*sent)(void *ctx);
    void (*wait_us)(void *ctx, uint32_t us);
};
enum { FAULT_TX_POLL_US = 10 };
/* Encodes m, queues every byte and waits until the transmitter reports them sent, at most limit_us; returns false on timeout. Used before a test reset, which otherwise cuts the bytes still queued. */
bool fault_send_complete(const struct fault_tx *tx, const struct epoch_msg *m, uint32_t limit_us);
/* Copies the newest valid record into the other slot with seq + 2 or the same seq and a correct CRC, w0 last, so both slots are valid and break the one-step rule. With CONFIG_EPOCH_FAULT_CORRUPT, mode FAULT_FORGE_SEQ_EQUAL instead changes bit 0 of word 5 of the newest valid slot and nothing else. Returns false and writes nothing when no slot is valid. */
bool fault_forge_pair(const struct epoch_journal_params *p, volatile uint32_t *slots, uint32_t era, uint32_t mode, epoch_barrier_fn barrier, void *ctx);

#endif
```

## src/retention_probe.c
```c
/* Retained-memory probe. Reports reset flags, FLASH_OPTR and two probe records, R1 in SRAM1 noinit and R2 in backup SRAM, as text lines on USART1.
 * A boot only observes: records are written solely by the host's I command, so a valid record after a reset was written before it.
 * Commands, one per line: "I <run> <gen>" writes both records, "R" reports again, "B" repeats the boot report (for a host that reconnects after power-up), "S" software reset, "W" independent watchdog reset. A pin reset is driven by the ST-LINK. */

#include <stdio.h>
#include <stdlib.h>
#include <string.h>

#include <soc.h>
#include <zephyr/device.h>
#include <zephyr/drivers/uart.h>
#include <zephyr/kernel.h>
#include <zephyr/linker/section_tags.h>
#include <zephyr/sys/reboot.h>

#include "epoch/crc32.h"

#define UART_NODE DT_CHOSEN(zephyr_console)
#define PROBE_WORDS 12u
#define PROBE_VERSION 1u
#define R1_MAGIC 0x45503152u /* "R1PE" little-endian */
#define R2_MAGIC 0x45503252u
#define R2_MARKER 0xB2C0FFEEu /* TAMP_BKP31R: backup SRAM probe words were written since the last backup-domain reset */

/* w0 magic, w1 version, w2 backend, w3 run, w4 generation, w5..w8 fixed patterns, w9 ~generation, w10 run ^ generation ^ 0xA5A5A5A5, w11 CRC-32 of w0..w10. */
static const uint32_t patterns[4] = {0x00000000u, 0xFFFFFFFFu, 0xAAAAAAAAu, 0x55555555u};

static __noinit uint32_t r1_words[PROBE_WORDS];                  /* R1: SRAM1, not cleared by startup */
static __stm32_backup_sram_section uint32_t r2_words[PROBE_WORDS]; /* R2: backup SRAM */

static const struct device *const uart = DEVICE_DT_GET(UART_NODE);

static void out(const char *s)
{
    while (*s) {
        uart_poll_out(uart, *s++);
    }
}

static void build(uint32_t w[PROBE_WORDS], uint32_t magic, uint32_t backend, uint32_t run, uint32_t gen)
{
    w[0] = magic;
    w[1] = PROBE_VERSION;
    w[2] = backend;
    w[3] = run;
    w[4] = gen;
    memcpy(&w[5], patterns, sizeof(patterns));
    w[9] = ~gen;
    w[10] = run ^ gen ^ 0xA5A5A5A5u;
    w[11] = epoch_crc32_words(w, PROBE_WORDS - 1u);
}

/* Aligned 32-bit stores through volatile, w0 last, so a torn write never shows the magic. */
static void store(volatile uint32_t *dst, const uint32_t w[PROBE_WORDS])
{
    dst[0] = 0;
    __DSB();
    for (unsigned i = 1; i < PROBE_WORDS; i++) {
        dst[i] = w[i];
    }
    __DSB();
    dst[0] = w[0];
    __DSB();
}

static const char *classify(const uint32_t w[PROBE_WORDS], uint32_t magic, uint32_t backend)
{
    uint32_t expect[PROBE_WORDS];
    unsigned zeros = 0;
    for (unsigned i = 0; i < PROBE_WORDS; i++) {
        zeros += w[i] == 0;
    }
    if (zeros == PROBE_WORDS) {
        return "ZERO";
    }
    if (w[0] != magic) {
        return "NO_MAGIC";
    }
    build(expect, magic, backend, w[3], w[4]);
    return memcmp(expect, w, sizeof(expect)) == 0 ? "VALID" : "CORRUPT";
}

static void report_record(const char *name, const volatile uint32_t *src, uint32_t magic, uint32_t backend)
{
    uint32_t w[PROBE_WORDS];
    char line[200];
    for (unsigned i = 0; i < PROBE_WORDS; i++) {
        w[i] = src[i];
    }
    snprintf(line, sizeof(line), "%s %s run=%lu gen=%lu raw=", name, classify(w, magic, backend), (unsigned long)w[3], (unsigned long)w[4]);
    out(line);
    for (unsigned i = 0; i < PROBE_WORDS; i++) {
        snprintf(line, sizeof(line), "%08lx%s", (unsigned long)w[i], i + 1 < PROBE_WORDS ? "," : "\r\n");
        out(line);
    }
}

static bool r2_readable(void)
{
    /* Unwritten words are only a hazard with BKPRAM ECC on (FLASH_OPTR.BKPRAM_ECC = 0 enables it). */
    return TAMP->BKP31R == R2_MARKER || (FLASH->OPTR & FLASH_OPTR_BKPRAM_ECC) != 0u;
}

static void report(void)
{
    report_record("R1", r1_words, R1_MAGIC, 1);
    if (r2_readable()) {
        report_record("R2", r2_words, R2_MAGIC, 2);
    } else {
        /* With BKPRAM ECC enabled, reading words never written since power-up may report ECC errors, so R2 is read only after this probe wrote it. */
        out("R2 NOT_READ marker absent and ECC enabled\r\n");
    }
}

static void watchdog_reset(void)
{
    IWDG->KR = 0xCCCCu; /* start; LSI 32 kHz */
    IWDG->KR = 0x5555u; /* unlock PR and RLR */
    IWDG->PR = 0;       /* divide by 4 */
    IWDG->RLR = 0xFFu;  /* 256 ticks, about 32 ms */
    while (IWDG->SR != 0u) {
    }
    IWDG->KR = 0xAAAAu;
    for (;;) {
    }
}

static size_t read_line(char *buf, size_t cap)
{
    size_t n = 0;
    unsigned char c;
    for (;;) {
        if (uart_poll_in(uart, &c) != 0) {
            continue; /* busy poll: USART1 has no RX FIFO here, so sleeping between polls overruns the next byte */
        }
        if (c == '\n' || c == '\r') {
            if (n) {
                buf[n] = '\0';
                return n;
            }
            continue;
        }
        if (n + 1 < cap) {
            buf[n++] = (char)c;
        }
    }
}

static void boot_report(uint32_t csr, uint32_t optr)
{
    char line[160];
    snprintf(line, sizeof(line), "BOOT probe=%u csr=%08lx optr=%08lx r1_addr=%08lx r2_addr=%08lx bkp31=%08lx\r\n", PROBE_VERSION,
             (unsigned long)csr, (unsigned long)optr, (unsigned long)(uintptr_t)r1_words, (unsigned long)(uintptr_t)r2_words,
             (unsigned long)TAMP->BKP31R);
    out(line);
    report();
    out("READY\r\n");
}

int main(void)
{
    /* Captured before anything else; nothing in this image clears RCC_CSR earlier (CONFIG_HWINFO is off). */
    const uint32_t csr = RCC->CSR;
    const uint32_t optr = FLASH->OPTR;
    RCC->CSR |= RCC_CSR_RMVF; /* flags accumulate otherwise; the next boot then sees only its own reset */

    if (!device_is_ready(uart)) {
        return -1;
    }
    RCC->APB3ENR |= RCC_APB3ENR_RTCAPBEN; /* TAMP registers */
    (void)RCC->APB3ENR;

    boot_report(csr, optr);

    for (;;) {
        char cmd[64];
        read_line(cmd, sizeof(cmd));
        if (cmd[0] == 'I' && cmd[1] == ' ') {
            char *end;
            unsigned long run = strtoul(cmd + 2, &end, 10);
            unsigned long gen = strtoul(end, NULL, 10);
            uint32_t w[PROBE_WORDS];
            build(w, R1_MAGIC, 1, (uint32_t)run, (uint32_t)gen);
            store(r1_words, w);
            build(w, R2_MAGIC, 2, (uint32_t)run, (uint32_t)gen);
            store(r2_words, w);
            TAMP->BKP31R = R2_MARKER; /* after the words, so the marker never vouches for unwritten ECC words */
            __DSB();
            out("OK I\r\n");
            report();
        } else if (strcmp(cmd, "B") == 0) {
            boot_report(csr, optr);
        } else if (strcmp(cmd, "R") == 0) {
            report();
        } else if (strcmp(cmd, "S") == 0) {
            out("OK S\r\n");
            k_msleep(5); /* let the last byte leave the shift register */
            sys_reboot(SYS_REBOOT_COLD);
        } else if (strcmp(cmd, "W") == 0) {
            out("OK W\r\n");
            k_msleep(5);
            watchdog_reset();
        } else {
            out("ERR\r\n");
        }
    }
}
```
